## layers/meta-ciphervault/conf/layer.conf
```bitbake
# We have a conf and classes directory, add to BBPATH
BBPATH .= ":${LAYERDIR}"

# We have recipes-* directories, add to BBFILES
BBFILES += "${LAYERDIR}/recipes-*/*/*.bb \
            ${LAYERDIR}/recipes-*/*/*.bbappend"

BBFILE_COLLECTIONS += "ciphervault"
BBFILE_PATTERN_ciphervault = "^${LAYERDIR}/"
BBFILE_PRIORITY_ciphervault = "5"
LAYERVERSION_ciphervault = "4"
LAYERSERIES_COMPAT_ciphervault = "dunfell"
```

## yocto/meta-ciphervault/conf/layer.conf
```bitbake
# We have a conf and classes directory, add to BBPATH
BBPATH .= ":${LAYERDIR}"

# We have recipes-* directories, add to BBFILES
BBFILES += "${LAYERDIR}/recipes-*/*/*.bb \
            ${LAYERDIR}/recipes-*/*/*.bbappend"

BBFILE_COLLECTIONS += "meta-ciphervault"
BBFILE_PATTERN_meta-ciphervault = "^${LAYERDIR}/"
BBFILE_PRIORITY_meta-ciphervault = "6"

LAYERDEPENDS_meta-ciphervault = "core"
LAYERSERIES_COMPAT_meta-ciphervault = "mickledore"
```

## yocto/poky/build/conf/bblayers.conf
```bitbake
# POKY_BBLAYERS_CONF_VERSION is increased each time build/conf/bblayers.conf
# changes incompatibly
POKY_BBLAYERS_CONF_VERSION = "2"

BBPATH = "${TOPDIR}"
BBFILES ?= ""

BBLAYERS ?= " \
  /home/vaultlinux/yocto/poky/meta \
  /home/vaultlinux/yocto/poky/meta-poky \
  /home/vaultlinux/yocto/poky/meta-yocto-bsp \
  /home/vaultlinux/yocto/meta-oe \
  /home/vaultlinux/yocto/meta-webserver \
  /home/vaultlinux/yocto/meta-ciphervault \
  "
```
